/**
  * @file    oled.c
  * @brief   0.96寸 OLED 显示模块实现（SSD1306，128x64，软件I2C）
  *          显存缓冲 + 局部刷新：不闪烁，只发变化的字节，比逐字直写效率高
  */
#include "oled.h"
#include "main.h"
#include <string.h>

/* ──── 移植配置（换项目必看）────
 * 换项目需要改：
 *   1. 下面的 SCL/SDA 引脚：改成你新项目的引脚宏
 *      （引脚要先在 CubeMX 里配成 GPIO 开漏输出+上拉，或推挽）
 *   2. OLED_ADDR：多数0.78；若白屏且引脚没错，试 0x7A
 * 不需要改：
 *   其他代码都不用动。屏幕尺寸固定128x64（0.96寸标准屏）。
 */
#define OLED_SCL_GPIO    OLED_SCL_GPIO_Port   /* SCL 端口 */
#define OLED_SCL         OLED_SCL_Pin         /* SCL 引脚 */
#define OLED_SDA_GPIO    OLED_SDA_GPIO_Port   /* SDA 端口 */
#define OLED_SDA         OLED_SDA_Pin         /* SDA 引脚 */
#define OLED_ADDR        0x78                 /* I2C地址(7位左移1位)，多数屏为0x78，白屏可试0x7A */

/* 显存：128x64/8 = 1024字节；Prev 记录上次上屏内容，用于局部刷新 */
static uint8_t OLED_Buf[OLED_WIDTH * OLED_HEIGHT / 8];
static uint8_t OLED_Prev[OLED_WIDTH * OLED_HEIGHT / 8];

/* 6x8 字体（ASCII 0x20~0x7E），每个字符6字节，最后一列留空当字间距 */
static const uint8_t OLED_Font[95][6] = {
  {0x00,0x00,0x00,0x00,0x00,0x00}, /*   */
  {0x00,0x00,0x5F,0x00,0x00,0x00}, /* ! */
  {0x00,0x07,0x00,0x07,0x00,0x00}, /* " */
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  {0x08,0x04,0x08,0x10,0x08,0x00}, /* ~ */
};

/* ──── 软件I2C ──── */
static void OLED_I2C_Start(void)
{
  HAL_GPIO_WritePin(OLED_SDA_GPIO, OLED_SDA, GPIO_PIN_SET);
  HAL_GPIO_WritePin(OLED_SCL_GPIO, OLED_SCL, GPIO_PIN_SET);
  HAL_GPIO_WritePin(OLED_SDA_GPIO, OLED_SDA, GPIO_PIN_RESET);
  HAL_GPIO_WritePin(OLED_SCL_GPIO, OLED_SCL, GPIO_PIN_RESET);
}

static void OLED_I2C_Stop(void)
{
  HAL_GPIO_WritePin(OLED_SDA_GPIO, OLED_SDA, GPIO_PIN_RESET);
  HAL_GPIO_WritePin(OLED_SCL_GPIO, OLED_SCL, GPIO_PIN_SET);
  HAL_GPIO_WritePin(OLED_SDA_GPIO, OLED_SDA, GPIO_PIN_SET);
}

static void OLED_I2C_WriteByte(uint8_t byte)
{
  uint8_t i;
  for (i = 0; i < 8; i++)
  {
    HAL_GPIO_WritePin(OLED_SDA_GPIO, OLED_SDA,
                      (byte & 0x80) ? GPIO_PIN_SET : GPIO_PIN_RESET);
    byte <<= 1;
    /* 高电平脉宽加长，方便示波器观察，也提高软件I2C鲁棒性 */
    HAL_GPIO_WritePin(OLED_SCL_GPIO, OLED_SCL, GPIO_PIN_SET);
    HAL_GPIO_WritePin(OLED_SCL_GPIO, OLED_SCL, GPIO_PIN_RESET);
  }
  /* 第9个时钟：忽略从机应答 */
  HAL_GPIO_WritePin(OLED_SCL_GPIO, OLED_SCL, GPIO_PIN_SET);
  HAL_GPIO_WritePin(OLED_SCL_GPIO, OLED_SCL, GPIO_PIN_RESET);
}

/* 发送一帧：mode=0x00命令 / 0x40数据 */
static void OLED_Send(uint8_t mode, const uint8_t *data, uint16_t len)
{
  uint16_t i;
  OLED_I2C_Start();
  OLED_I2C_WriteByte(OLED_ADDR);
  OLED_I2C_WriteByte(mode);
  for (i = 0; i < len; i++) OLED_I2C_WriteByte(data[i]);
  OLED_I2C_Stop();
}

static void OLED_WriteCmd(uint8_t cmd)
{
  OLED_Send(0x00, &cmd, 1);
}

/* ──── 初始化（标准 SSD1306 初始化序列，128x64）──── */
void OLED_Init(void)
{
  uint8_t cmds[] = {
    0xAE,             /* 关闭显示 */
    0x20, 0x00,       /* 水平寻址模式 */
    0x21, 0x00, 0x7F, /* 列地址 0~127 */
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    0xA6,             /* 不反色 */
    0xAF              /* 开启显示 */
  };
  uint8_t i;
  for (i = 0; i < sizeof(cmds); i++) OLED_WriteCmd(cmds[i]);

  /* 首次上屏把全屏清掉（Prev置0xFF强制第一次全发） */
  memset(OLED_Buf, 0, sizeof(OLED_Buf));
  memset(OLED_Prev, 0xFF, sizeof(OLED_Prev));
  OLED_Update();
}

/* ──── 显存操作 ──── */
void OLED_Clear(void)
{
  memset(OLED_Buf, 0, sizeof(OLED_Buf));
}

void OLED_Update(void)
{
  uint8_t page;
  for (page = 0; page < OLED_PAGES; page++)
  {
    uint8_t *cur  = &OLED_Buf[page * OLED_WIDTH];
    uint8_t *prev = &OLED_Prev[page * OLED_WIDTH];
    if (memcmp(cur, prev, OLED_WIDTH) == 0) continue;   /* 本页没变化，跳过 */

    uint8_t cmds[3] = {0xB0 + page, 0x10, 0x00};        /* 设页 + 列=0 */
    OLED_Send(0x00, cmds, 3);
    OLED_Send(0x40, cur, OLED_WIDTH);                   /* 整页128字节 */
    memcpy(prev, cur, OLED_WIDTH);
  }
}

/* 画一个字符到显存（x:列0~15 y:行0~7） */
static void OLED_DrawChar(uint8_t x, uint8_t y, char ch)
{
  uint8_t i;
  if (x > 15 || y > 7) return;
  if (ch < 0x20 || ch > 0x7E) ch = ' ';
  uint8_t *p = &OLED_Buf[y * OLED_WIDTH + x * 8];
  for (i = 0; i < 8; i++) p[i] = 0;                     /* 清8列再画6列 */
  for (i = 0; i < 6; i++) p[i] = OLED_Font[ch - 0x20][i];
}

/* ──── 对外显示接口 ──── */
void OLED_ShowString(uint8_t x, uint8_t y, const char *str)
{
  while (*str != '\0')
  {
    if (x > 15) break;
    OLED_DrawChar(x, y, *str);
    x++;
    str++;
  }
}

void OLED_ShowNumber(uint8_t x, uint8_t y, int32_t num, uint8_t len)
{
  char buf[12];
  uint8_t i, negative = 0;
  int32_t n = num;
  if (len > 10) len = 10;
  if (n < 0) { negative = 1; n = -n; }   /* n取正；对INT32_MIN会溢出，但显示10位以内不涉及 */
  for (i = len; i > 0; i--)
  {
    buf[i - 1] = (char)('0' + (n % 10));
    n /= 10;
  }
  if (negative && len > 0) buf[0] = '-';
  buf[len] = '\0';
  OLED_ShowString(x, y, buf);
}

void OLED_ShowDecimal(uint8_t x, uint8_t y, float num, uint8_t ilen, uint8_t flen)
{
  if (num < 0)
  {
    OLED_ShowString(x, y, "-");
    x++;
    num = -num;
  }

  int32_t ipart = (int32_t)num;
  int32_t scale = 1;
  uint8_t i;
  if (flen > 9) flen = 9;                      /* 防止scale溢出 */
  for (i = 0; i < flen; i++) scale *= 10;
  int32_t fpart = (int32_t)((num - ipart) * scale + 0.5f);   /* 四舍五入 */
  if (fpart >= scale) { fpart = 0; ipart++; }                /* 小数进位到整数 */

  OLED_ShowNumber(x, y, ipart, ilen);
  x += ilen;
  if (x > 15) return;
  OLED_ShowString(x, y, ".");
  OLED_ShowNumber(x + 1, y, fpart, flen);
}
